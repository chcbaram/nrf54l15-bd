#include "XIAO_NRF54L15_nrf54l15_cpuflpr.dts"

/ {
	compatible = "BARAM,XIAO-NRF54L15-cpuflpr-xip";
};

&cpuflpr_sram {
	reg = <0x2002f000 DT_SIZE_K(68)>;
	ranges = <0x0 0x2002f000 DT_SIZE_K(68)>;
};

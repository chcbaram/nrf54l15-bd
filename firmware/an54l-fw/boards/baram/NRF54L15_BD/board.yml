## firmware/an54l-fw/boards/baram/NRF54L15_BD/board.yml
```yaml
board:
  name: NRF54L15_BD
  vendor: baram
  socs:
  - name: nrf54l15
    variants:
    - name: xip
      cpucluster: cpuflpr
```

## firmware/xiao-nrf54l-fw/boards/baram/XIAO_NRF54L15/board.yml
```yaml
board:
  name: XIAO_NRF54L15
  vendor: BARAM
  socs:
  - name: nrf54l15
    variants:
    - name: xip
      cpucluster: cpuflpr
```
